## board/freescale/imx8mp_evk/Kconfig
```kconfig
if TARGET_IMX8MP_EVK || TARGET_IMX8MP_DDR4_EVK

config SYS_BOARD
	default "imx8mp_evk"

config SYS_VENDOR
	default "freescale"

config SYS_CONFIG_NAME
	default "imx8mp_evk"

config IMX_CONFIG
	default "board/freescale/imx8mp_evk/imximage-8mp-lpddr4.cfg"

config FACTORY_TEST
	bool "Enable Factory Test Routines"
	default n
	help
	  Enables custom memory tests for factory diagnostics.

config TARGET_IMX8MP_EDC_BRD01
	bool "Enable target to EDC board"
	default n
	help
	  Enables target board to EDC board.

endif
```

## board/freescale/imx94_evk/Kconfig
```kconfig
if TARGET_IMX943_EVK

config SYS_BOARD
	default "imx94_evk"

config SYS_VENDOR
	default "freescale"

config SYS_CONFIG_NAME
	default "imx94_evk"

config SM_CONFIG_NAME
	string "System Manager config name to power on M-core MIXs"
	default "mx94evkrpmsg"
	help
	  This string is the specified System Manager config name with which
	  the M-core MIXs (M7MIX0, M7MIX1 and NETC MIX) will be powered on.

endif
```

## board/nxp/imx95_evk/Kconfig
```kconfig
if TARGET_IMX95_19X19_EVK || TARGET_IMX95_15X15_EVK

config SYS_BOARD
	default "imx95_evk"

config SYS_VENDOR
	default "nxp"

config SYS_CONFIG_NAME
	default "imx95_evk"

config SM_CONFIG_NAME
	string "System Manager config name to power on M7MIX"
	default "mx95evkrpmsg"
	help
	  This string is the specified System Manager config name with which
	  the M7MIX will be powered on.

endif
```
