// SPDX-License-Identifier: (GPL-2.0+ OR MIT)
/*
 * Copyright 2023 NXP
 */

/dts-v1/;

#include "imx93-9x9-qsb.dts"
#include "imx93-9x9-qsb-u-boot.dtsi"
#include "imx93-9x9-qsb-ontat-wvga-panel.dtsi"

/{
	chosen {
		stdout-path = &lpuart2;
	};
};
