## configs/ls1046ardb_baremetal_slave_defconfig
```kconfig
CONFIG_ARM=y
CONFIG_TARGET_LS1046ARDB=y
CONFIG_SYS_TEXT_BASE=0x84000000
CONFIG_SYS_MALLOC_LEN=0x102000
CONFIG_NR_DRAM_BANKS=2
CONFIG_SYS_I2C=y
CONFIG_SYS_I2C_MXC=y
CONFIG_SYS_I2C_MXC_I2C1=y
CONFIG_SYS_I2C_MXC_I2C2=y
CONFIG_SYS_I2C_MXC_I2C3=y
CONFIG_SYS_I2C_MXC_I2C4=y
CONFIG_DM_GPIO=y
CONFIG_MPC8XXX_GPIO=y
CONFIG_DEFAULT_DEVICE_TREE="fsl-ls1046a-rdb"
CONFIG_QSPI_AHB_INIT=y=y
CONFIG_FIT_VERBOSE=y
CONFIG_OF_BOARD_SETUP=y
CONFIG_QSPI_BOOT=y
CONFIG_BOOTDELAY=0
CONFIG_HUSH_PARSER=y
# CONFIG_CMD_IMLS is not set
CONFIG_CMD_GPT=y
CONFIG_CMD_MMC=y
CONFIG_CMD_SF=y
CONFIG_CMD_I2C=y
CONFIG_CMD_USB=y
CONFIG_CMD_DHCP=y
CONFIG_CMD_MII=y
CONFIG_CMD_PING=y
CONFIG_CMD_CACHE=y
CONFIG_CMD_EXT2=y
CONFIG_CMD_FAT=y
CONFIG_CMD_MATH=y
CONFIG_OF_CONTROL=y
CONFIG_MP=y
CONFIG_DM=y
CONFIG_FSL_CAAM=y
CONFIG_SPI_FLASH=y
CONFIG_DM_I2C=y
CONFIG_I2C_SET_DEFAULT_BUS_NUM=y
CONFIG_SYS_I2C_EEPROM_ADDR=0x53
CONFIG_FSL_ESDHC=y
CONFIG_NAND_FSL_IFC=y
CONFIG_SYS_NAND_ONFI_DETECTION=y
# CONFIG_SPI_FLASH_BAR is not set
CONFIG_SPI_FLASH_SPANSION=y
# CONFIG_SPI_FLASH_USE_4K_SECTORS is not set
CONFIG_NETDEVICES=y
CONFIG_PHYLIB=y
CONFIG_PHY_AQUANTIA=y
CONFIG_PHY_REALTEK=y
CONFIG_PHY_FIXED=y
CONFIG_DM_ETH=n
CONFIG_DM_MDIO=n
CONFIG_E1000=y
CONFIG_FMAN_ENET=y
CONFIG_SYS_FMAN_FW_ADDR=0x900000
CONFIG_NVME_PCI=y
CONFIG_PCI=y
CONFIG_DM_PCI=y
CONFIG_DM_PCI_COMPAT=y
CONFIG_PCIE_LAYERSCAPE_RC=y
CONFIG_PCIE_LAYERSCAPE_EP=y
CONFIG_POWER_LEGACY=y
CONFIG_POWER_I2C=y
CONFIG_DM_SCSI=y
CONFIG_SYS_NS16550=y
CONFIG_SPI=y
CONFIG_DM_SPI=y
CONFIG_FSL_QSPI=y
CONFIG_USB=y
CONFIG_USB_XHCI_HCD=y
CONFIG_USB_XHCI_DWC3=y
CONFIG_USB_STORAGE=y
CONFIG_DISTRO_DEFAULTS=y
CONFIG_CMD_NAND=y
CONFIG_MTD=y
CONFIG_MTD_RAW_NAND=y
CONFIG_IFC_COREID_SET=y
CONFIG_BAREMETAL=y
CONFIG_CONS_INDEX=2
CONFIG_BAREMETAL_SLAVE_MODE=y
CONFIG_ENABLE_COREID_DEBUG=y
CONFIG_ENABLE_WRITE_LOCK=y
CONFIG_FMAN_COREID_SET=y
CONFIG_FMAN_FMAN1_COREID=0
CONFIG_I2C_COREID_SET=y
CONFIG_SYS_I2C_MXC_I2C0_COREID=0
CONFIG_SYS_I2C_MXC_I2C1_COREID=1
CONFIG_SYS_I2C_MXC_I2C2_COREID=2
CONFIG_SYS_I2C_MXC_I2C3_COREID=3
CONFIG_IRQ_COREID_SET=y
CONFIG_QSPI_COREID_SET=y
CONFIG_USB_COREID_SET=y
CONFIG_USB_USB0_COREID=0
CONFIG_USB_USB1_COREID=1
CONFIG_USB_USB2_COREID=3
CONFIG_USB_CTL_NUM=3
CONFIG_PCIE_COREID_SET=y
CONFIG_PCIE_PCIE1_COREID=0
CONFIG_PCIE_PCIE2_COREID=1
CONFIG_PCIE_PCIE3_COREID=2
CONFIG_PCIE_CTL_NUM=3
```

## configs/lx2160ardb_baremetal_slave_defconfig
```kconfig
CONFIG_ARM=y
CONFIG_TARGET_LX2160ARDB=y
CONFIG_TFABOOT=y
CONFIG_TEXT_BASE=0x84000000
CONFIG_SYS_MALLOC_LEN=0x202000
CONFIG_SYS_MALLOC_F_LEN=0x6000
CONFIG_DM_GPIO=y
CONFIG_DEFAULT_DEVICE_TREE="fsl-lx2160a-rdb"
CONFIG_FSPI_AHB_EN_4BYTE=y
CONFIG_ARMV8_SEC_FIRMWARE_SUPPORT=y
CONFIG_AHCI=y
CONFIG_FSL_USE_PCA9547_MUX=y
CONFIG_SYS_FSL_NUM_CC_PLLS=4
CONFIG_FSL_QIXIS=y
CONFIG_SYS_MONITOR_LEN=958464
CONFIG_MP=y
CONFIG_DYNAMIC_SYS_CLK_FREQ=y
CONFIG_RESET_PHY_R=y
CONFIG_SYS_MAXARGS=64
CONFIG_SYS_PBSIZE=532
CONFIG_CMD_GPT=y
CONFIG_CMD_I2C=y
CONFIG_CMD_MMC=y
CONFIG_CMD_PCI=y
CONFIG_CMD_SF=y
CONFIG_CMD_USB=y
CONFIG_CMD_CACHE=y
CONFIG_OF_CONTROL=y
CONFIG_ENV_OVERWRITE=n
CONFIG_ENV_IS_IN_MMC=n
CONFIG_ENV_IS_IN_SPI_FLASH=n
CONFIG_USE_ETHPRIME=y
CONFIG_ETHPRIME="DPMAC1@xgmii"
CONFIG_NET_RANDOM_ETHADDR=y
CONFIG_DM=y
CONFIG_DM_MMC=y
CONFIG_DYNAMIC_DDR_CLK_FREQ=y
CONFIG_DIMM_SLOTS_PER_CTLR=2
CONFIG_SYS_FSL_DDR_INTLV_256B=y
CONFIG_DM_I2C=y
CONFIG_I2C_SET_DEFAULT_BUS_NUM=y
CONFIG_I2C_DEFAULT_BUS_NUMBER=0
CONFIG_FSL_ESDHC=y
CONFIG_DM_SPI_FLASH=y
CONFIG_SPI_FLASH=y
CONFIG_SPI_FLASH_SPANSION=y
CONFIG_SPI_FLASH_STMICRO=y
CONFIG_PHYLIB=y
CONFIG_FSL_MEMAC=y
CONFIG_E1000=y
CONFIG_PCI=y
CONFIG_DM_PCI=y
CONFIG_DM_PCI_COMPAT=y
CONFIG_PCIE_LAYERSCAPE_GEN4=y
CONFIG_DM_RTC=y
CONFIG_DM_SCSI=y
CONFIG_SPI=y
CONFIG_DM_SPI=y
CONFIG_NXP_FSPI=y
CONFIG_USB=y
CONFIG_DM_USB=y
CONFIG_USB_MAX_CONTROLLER_COUNT=2
CONFIG_BAREMETAL=y
CONFIG_CONS_INDEX=1
CONFIG_CMD_IRQ=y
CONFIG_BAREMETAL_SLAVE_MODE=y
CONFIG_IRQ=y
```

## drivers/flexcan/Kconfig
```kconfig
#
# flexcan subsystem configuration
#

menu "CAN support"

config FSL_FLEXCAN
	bool "Support for Freescale FLEXCAN based chips"
	default n
	help
	  Say Y here if you want to support for Freescale FlexCAN.

if FSL_FLEXCAN

config CANFESTIVAL
	bool "Support for canfestival"
	default n
	help
	  Say Y here if you want to support for canfestival(CANopen protocol).

if CANFESTIVAL

config CANFESTIVAL_LSS
	bool "Support for LSS"
	default n
	help
	  Say Y here if you want to support for LSS(Layer setting services).

endif

endif #FSL_FLEXCAN

endmenu
```
