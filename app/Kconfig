## app/Kconfig
```kconfig
#
# BareMetal configuration
#

menu "BareMetal"

config BAREMETAL
	bool "Support BareMetal features"
	help
	  This provides a command to start BareMetal on slave
	  cores, and add some features to support BareMetal.

if BAREMETAL

config BAREMETAL_SLAVE_MODE
	bool "The slave core running BareMetal binary"
	default n
	help
	  the slave mode running on the slave cores

config ENABLE_WRITE_LOCK
	bool "lock the consol output for a core"
	default n

config ENABLE_COREID_DEBUG
	bool "Add coreid to the log"
	default n

endif

config GPIO_COREID_SET
	bool "Enable GPIO for BareMetal"
	depends on BAREMETAL
if GPIO_COREID_SET
config GPIO_GPIO0_COREID
	int "The core GPIO0 assigned"
	default 0

config GPIO_GPIO1_COREID
	int "The core GPIO1 assigned"
	default 0

config GPIO_GPIO2_COREID
	int "The core GPIO2 assigned"
	default 0
endif

config I2C_COREID_SET
	bool "Enable I2C for BareMetal"
	depends on BAREMETAL
	default n

if I2C_COREID_SET
config SYS_I2C_MXC_I2C0_COREID
	int "The core I2C0 assigned"
	default 0

config SYS_I2C_MXC_I2C1_COREID
	int "The core I2C1 assigned"
	default 0

config SYS_I2C_MXC_I2C2_COREID
	int "The core I2C2 assigned"
	default 0

config SYS_I2C_MXC_I2C3_COREID
	int "The core I2C3 assigned"
	default 0
endif

config IRQ_COREID_SET
	bool "Enable IRQ for BareMetal"
	depends on BAREMETAL && IRQ
	default n

config ICC_COREID_SET
	bool "Enable ICC test for BareMetal"
	depends on BAREMETAL && IRQ
	default y

config QSPI_COREID_SET
	bool "Enable QSPI for BareMetal"
	depends on BAREMETAL
	default n

if QSPI_COREID_SET
config QSPI_QSPI0_COREID
	int "The core QSPI0 assigned"
	default 1
endif

config FMAN_COREID_SET
	bool "Enable FMAN for BareMetal"
	depends on BAREMETAL
	default n

if FMAN_COREID_SET
config FMAN_FMAN1_COREID
	int "The coer FMAN1 assigned"
	default "1"
endif

config USB_COREID_SET
	bool "Enable USB for BareMetal"
	depends on BAREMETAL
	default n

if USB_COREID_SET
config USB_USB0_COREID
	int "The core USB0 assigned"
	default 0

config USB_USB1_COREID
	int "The core USB1 assigned"
	default 0

config USB_USB2_COREID
	int "The core USB2 assigned"
	default 0

config USB_CTL_NUM
	int "USB Controller numbers "
	default 1
endif

config PCIE_COREID_SET
	bool "Enable PCIE for BareMetal"
	depends on BAREMETAL
	default n

if PCIE_COREID_SET
config PCIE_PCIE1_COREID
	int "The core PCIe1 assigned"
	default "0"

config PCIE_PCIE2_COREID
	int "The core PCIe2 assigned"
	default "0"

config PCIE_PCIE3_COREID
	int "The core PCIe3 assigned"
	default "0"

config PCIE_CTL_NUM
	int "PCIe Controller numbers "
	default "3"
endif

config CAN_COREID_SET
	bool "Enable FlexCAN for BareMetal"
	depends on BAREMETAL
	default n

config ENETC_COREID_SET
	bool "Enable ENETC for BareMetal"
	depends on BAREMETAL
	default n

if ENETC_COREID_SET
config ENETC_ENETC1_COREID
	int "The core Enetc1 assigned"
	default "1"

config ENETC_CTL_NUM
	int "ENETC controller numbers"
	default "1"
endif

config SAI_COREID_SET
	bool "Enable SAI for BareMetal"
	depends on BAREMETAL
	default n

config IFC_COREID_SET
	bool "Enable IFC for BareMetal"
	depends on BAREMETAL
	default n

if IFC_COREID_SET
config IFC_COREID
	int "The core IFC assigned"
	default "1"
endif

config FEC_COREID_SET
	bool "Enable FEC MXC for BareMetal"
	depends on BAREMETAL
	default n

if FEC_COREID_SET
config FEC_NIC0_COREID
	int "The core FEC MXC assigned"
	default "1"
endif

endmenu
```

## board/freescale/ls1021aiot/Kconfig
```kconfig
if TARGET_LS1021AIOT

config SYS_BOARD
	default "ls1021aiot"

config SYS_VENDOR
	default "freescale"

config SYS_SOC
	default "ls102xa"

config SYS_CONFIG_NAME
	default "ls1021aiot"

config BM_CAN
	bool "Can3/4 supported"
	depends on BAREMETAL

config BM_GPIO
	bool "GPIO3_15/27 supported"
	depends on BAREMETAL

source "board/freescale/common/Kconfig"

endif
```

## configs/imx8mm_evk_baremetal_slave_defconfig
```kconfig
CONFIG_ARM=y
CONFIG_SPL_SYS_ICACHE_OFF=y
CONFIG_SPL_SYS_DCACHE_OFF=y
CONFIG_ARCH_IMX8M=y
CONFIG_ARMV8_SET_SMPEN=y
CONFIG_TEXT_BASE=0x50200000
CONFIG_SYS_MALLOC_LEN=0xb00000
CONFIG_SYS_MALLOC_F_LEN=0x20000
CONFIG_SPL_GPIO=y
CONFIG_SPL_LIBCOMMON_SUPPORT=y
CONFIG_SPL_LIBGENERIC_SUPPORT=y
CONFIG_ENV_SIZE=0x4000
CONFIG_ENV_OFFSET=0x400000
CONFIG_SYS_MEMTEST_START=0x40000000
CONFIG_SYS_MEMTEST_END=0x80000000
CONFIG_SYS_I2C_MXC_I2C1=y
CONFIG_SYS_I2C_MXC_I2C2=y
CONFIG_SYS_I2C_MXC_I2C3=y
CONFIG_DM_GPIO=y
CONFIG_SPL_TEXT_BASE=0x7E1000
CONFIG_TARGET_IMX8MM_EVK=y
CONFIG_ARCH_MISC_INIT=y
CONFIG_SPL_MMC=n
CONFIG_SPL_SERIAL=n
CONFIG_SPL_DRIVERS_MISC=n
CONFIG_SPL=n
CONFIG_DEFAULT_DEVICE_TREE="imx8mm-evk"
CONFIG_CSF_SIZE=0x2000
CONFIG_DISTRO_DEFAULTS=n
CONFIG_BOOTCOMMAND="run distro_bootcmd;run bsp_bootcmd"
CONFIG_SYS_LOAD_ADDR=0x40400000
CONFIG_FIT=y
CONFIG_FIT_EXTERNAL_OFFSET=0x3000
CONFIG_IMX_CONFIG=""
CONFIG_SPL_LOAD_FIT=n
# CONFIG_USE_SPL_FIT_GENERATOR is not set
CONFIG_OF_SYSTEM_SETUP=y
CONFIG_BOARD_LATE_INIT=y
CONFIG_BOARD_EARLY_INIT_F=y
CONFIG_SPL_BOARD_INIT=y
CONFIG_SPL_SEPARATE_BSS=y
CONFIG_SYS_MMCSD_RAW_MODE_U_BOOT_USE_SECTOR=y
CONFIG_SYS_MMCSD_RAW_MODE_U_BOOT_SECTOR=0x300
CONFIG_SPL_I2C=y
CONFIG_SPL_POWER=y
CONFIG_SPL_WATCHDOG=y
CONFIG_NR_DRAM_BANKS=2
CONFIG_SYS_PROMPT="u-boot=> "
# CONFIG_CMD_EXPORTENV is not set
# CONFIG_CMD_IMPORTENV is not set
# CONFIG_CMD_CRC32 is not set
# CONFIG_BOOTM_NETBSD is not set
CONFIG_CMD_NVEDIT_EFI=y
CONFIG_CMD_CLK=y
CONFIG_CMD_GPIO=y
CONFIG_CMD_GPT=y
CONFIG_CMD_I2C=y
CONFIG_CMD_MMC=y
CONFIG_CMD_POWEROFF=y
CONFIG_CMD_PART=y
CONFIG_CMD_DHCP=y
CONFIG_CMD_MII=y
CONFIG_CMD_PING=y
CONFIG_CMD_CACHE=y
CONFIG_CMD_REGULATOR=y
CONFIG_CMD_MEMTEST=y
CONFIG_CMD_EXT2=y
CONFIG_CMD_EXT4=y
CONFIG_CMD_HASH=y
CONFIG_CMD_EXT4_WRITE=y
CONFIG_CMD_FAT=y
CONFIG_CMD_SF=y
CONFIG_CMD_FS_GENERIC=y
CONFIG_CMD_USB=y
CONFIG_CMD_USB_MASS_STORAGE=y
CONFIG_OF_CONTROL=y
CONFIG_ENV_OVERWRITE=n
CONFIG_DEFAULT_FDT_FILE="imx8mm-evk.dtb"
CONFIG_ENV_IS_IN_MMC=n
CONFIG_SYS_RELOC_GD_ENV_ADDR=y
CONFIG_SYS_MMC_ENV_DEV=1
CONFIG_ENV_VARS_UBOOT_RUNTIME_CONFIG=y
CONFIG_NET_RANDOM_ETHADDR=y
CONFIG_CLK_COMPOSITE_CCF=y
CONFIG_CLK_IMX8MM=y
CONFIG_DFU_TFTP=n
CONFIG_DFU_MMC=n
CONFIG_DFU_RAM=n
CONFIG_UDP_FUNCTION_FASTBOOT=y
CONFIG_MXC_GPIO=y
CONFIG_FASTBOOT=n
CONFIG_USB_FUNCTION_FASTBOOT=n
CONFIG_CMD_FASTBOOT=n
CONFIG_ANDROID_BOOT_IMAGE=n
CONFIG_FASTBOOT_UUU_SUPPORT=n
CONFIG_FASTBOOT_BUF_ADDR=0x42800000
CONFIG_FASTBOOT_BUF_SIZE=0x40000000
CONFIG_FASTBOOT_FLASH=n

CONFIG_DM_I2C=y
CONFIG_SPL_SYS_I2C_LEGACY=y
CONFIG_SYS_I2C_MXC=y
CONFIG_DM_MMC=y
CONFIG_EFI_PARTITION=y
CONFIG_SUPPORT_EMMC_RPMB=n
CONFIG_SUPPORT_EMMC_BOOT=y
CONFIG_MMC_IO_VOLTAGE=y
CONFIG_MMC_UHS_SUPPORT=y
CONFIG_MMC_HS400_ES_SUPPORT=y
CONFIG_MMC_HS400_SUPPORT=y
CONFIG_FSL_USDHC=n
CONFIG_FSL_ESDHC_IMX=y
CONFIG_DM_SPI_FLASH=y
CONFIG_DM_SPI=y
CONFIG_NXP_FSPI=y
CONFIG_SPI=y
CONFIG_SPI_FLASH=y
CONFIG_SPI_FLASH_BAR=y
CONFIG_SPI_FLASH_STMICRO=y
CONFIG_SF_DEFAULT_BUS=0
CONFIG_SF_DEFAULT_CS=0
CONFIG_SF_DEFAULT_SPEED=40000000
CONFIG_SF_DEFAULT_MODE=0

CONFIG_PHYLIB=y
CONFIG_PHY_ATHEROS=y
CONFIG_DM_ETH=y
CONFIG_PHY_GIGE=y
CONFIG_FEC_MXC=y
CONFIG_MII=y
CONFIG_PINCTRL=y
CONFIG_PINCTRL_IMX8M=y
CONFIG_SPL_POWER_LEGACY=n
CONFIG_DM_REGULATOR=y
CONFIG_DM_REGULATOR_FIXED=y
CONFIG_DM_REGULATOR_GPIO=y
CONFIG_SPL_POWER_I2C=n
CONFIG_DM_RTC=y
CONFIG_RTC_EMULATION=y
CONFIG_MXC_UART=y
CONFIG_SYSRESET=y
CONFIG_SYSRESET_PSCI=y
CONFIG_DM_THERMAL=y
CONFIG_IMX_TMU=y
CONFIG_USB_TCPC=y
CONFIG_USB=y
CONFIG_USB_GADGET=n
CONFIG_USB_STORAGE=y
CONFIG_DM_USB=y
CONFIG_CI_UDC=y
CONFIG_USB_EHCI_HCD=y
CONFIG_USB_HOST_ETHER=y
CONFIG_USB_ETHER_ASIX=y
CONFIG_USB_ETHER_RTL8152=y

CONFIG_USB_GADGET_MANUFACTURER="FSL"
CONFIG_USB_GADGET_VENDOR_NUM=0x1fc9
CONFIG_USB_GADGET_PRODUCT_NUM=0x0152

CONFIG_SPL_USB_HOST=n
CONFIG_SPL_USB_GADGET=n
CONFIG_SPL_USB_SDP_SUPPORT=n
CONFIG_SDP_LOADADDR=0x40400000

CONFIG_OF_LIBFDT_OVERLAY=y

CONFIG_REGMAP=y
CONFIG_SYSCON=y
CONFIG_DM_RESET=y
CONFIG_RESET_DISPMIX=y
CONFIG_VIDEO_IMX_SEC_DSI=n
CONFIG_DM_VIDEO=n

CONFIG_GIC_V3_ITS=y
CONFIG_BOOTDELAY=0

CONFIG_BAREMETAL=y
CONFIG_CONS_INDEX=2
CONFIG_BAREMETAL_SLAVE_MODE=y
CONFIG_FEC_COREID_SET=y
CONFIG_FEC_NIC0_COREID=1
CONFIG_GPIO_COREID_SET=y
CONFIG_GPIO_GPIO5_COREID=1
```

## configs/ls1021aiot_baremetal_slave_defconfig
```kconfig
CONFIG_ARM=y
CONFIG_TARGET_LS1021AIOT=y
CONFIG_SYS_TEXT_BASE=0x84000000
CONFIG_SYS_MALLOC_LEN=0x1002000
CONFIG_NR_DRAM_BANKS=1
CONFIG_ENV_SIZE=0x2000
CONFIG_ENV_OFFSET=0x100000
CONFIG_SYS_I2C_MXC_I2C1=y
CONFIG_SYS_I2C_MXC_I2C2=y
CONFIG_SYS_I2C_MXC_I2C3=y
CONFIG_DM_GPIO=y
CONFIG_DEFAULT_DEVICE_TREE="ls1021a-iot-duart"
CONFIG_AHCI=y
CONFIG_SYS_LOAD_ADDR=0x84000000
CONFIG_BOARD_EARLY_INIT_F=y
CONFIG_SYS_MMCSD_RAW_MODE_U_BOOT_USE_SECTOR=y
CONFIG_SYS_MMCSD_RAW_MODE_U_BOOT_SECTOR=0xe8
CONFIG_CMD_PING=y
CONFIG_CMD_GPT=y
CONFIG_CMD_FAT=y
# CONFIG_SPL_EFI_PARTITION is not set
CONFIG_OF_CONTROL=y
CONFIG_DM=y
CONFIG_SATA=y
CONFIG_SATA_CEVA=y
CONFIG_FSL_CAAM=y
CONFIG_ARCH_MISC_INIT=y
CONFIG_DM_I2C=y
CONFIG_I2C_SET_DEFAULT_BUS_NUM=y
CONFIG_SYS_I2C_EEPROM_ADDR=0x51
CONFIG_FSL_ESDHC=y
CONFIG_MTD=y
CONFIG_SPI_FLASH_ATMEL=y
CONFIG_SPI_FLASH_SPANSION=y
CONFIG_SPI_FLASH_STMICRO=y
CONFIG_PHY_ATHEROS=y
CONFIG_PHY_GIGE=y
CONFIG_E1000=y
CONFIG_MII=y
CONFIG_TSEC_ENET=y
CONFIG_NVME_PCI=y
CONFIG_PCI=y
CONFIG_DM_PCI_COMPAT=y
CONFIG_PCIE_LAYERSCAPE_RC=y
CONFIG_U_QE=y
CONFIG_SYS_QE_FW_ADDR=0xf40000
CONFIG_DM_SCSI=y
CONFIG_SYS_NS16550=y
CONFIG_SPI=y
CONFIG_DM_SPI=y
CONFIG_FSL_DSPI=y
CONFIG_FSL_QSPI=y
CONFIG_MP=y
CONFIG_BAREMETAL=y
CONFIG_CONS_INDEX=2
CONFIG_BAREMETAL_SLAVE_MODE=y
CONFIG_DM_RTC=y
CONFIG_RTC_FSL_FTM_ALARM=y
```

## configs/ls1021aiot_bm_defconfig
```kconfig
CONFIG_ARM=y
CONFIG_TARGET_LS1021AIOT=y
CONFIG_SYS_TEXT_BASE=0x84000000
CONFIG_SYS_MALLOC_LEN=0x1002000
CONFIG_NR_DRAM_BANKS=1
CONFIG_ENV_SIZE=0x2000
CONFIG_ENV_OFFSET=0x100000
CONFIG_SYS_I2C_MXC_I2C1=y
CONFIG_SYS_I2C_MXC_I2C2=y
CONFIG_SYS_I2C_MXC_I2C3=y
CONFIG_DM_GPIO=y
CONFIG_DEFAULT_DEVICE_TREE="ls1021a-iot-duart"
CONFIG_AHCI=y
CONFIG_SYS_LOAD_ADDR=0x84000000
CONFIG_BOARD_EARLY_INIT_F=y
CONFIG_SYS_MMCSD_RAW_MODE_U_BOOT_USE_SECTOR=y
CONFIG_SYS_MMCSD_RAW_MODE_U_BOOT_SECTOR=0xe8
CONFIG_CMD_PING=y
CONFIG_CMD_GPT=y
CONFIG_CMD_FAT=y
CONFIG_CMD_USB=y
# CONFIG_SPL_EFI_PARTITION is not set
CONFIG_OF_CONTROL=y
CONFIG_DM=y
CONFIG_SATA=y
CONFIG_SATA_CEVA=y
CONFIG_FSL_CAAM=y
CONFIG_ARCH_MISC_INIT=y
CONFIG_DM_I2C=y
CONFIG_I2C_SET_DEFAULT_BUS_NUM=y
CONFIG_SYS_I2C_EEPROM_ADDR=0x51
CONFIG_FSL_ESDHC=y
CONFIG_MTD=y
CONFIG_SPI_FLASH_ATMEL=y
CONFIG_SPI_FLASH_SPANSION=y
CONFIG_SPI_FLASH_STMICRO=y
CONFIG_PHY_ATHEROS=y
CONFIG_PHY_GIGE=y
CONFIG_E1000=y
CONFIG_MII=y
CONFIG_TSEC_ENET=y
CONFIG_NVME_PCI=y
CONFIG_PCI=y
CONFIG_DM_PCI_COMPAT=y
CONFIG_PCIE_LAYERSCAPE_RC=y
CONFIG_U_QE=y
CONFIG_SYS_QE_FW_ADDR=0xf40000
CONFIG_DM_SCSI=y
CONFIG_SYS_NS16550=y
CONFIG_SPI=y
CONFIG_DM_SPI=y
CONFIG_FSL_DSPI=y
CONFIG_FSL_QSPI=y
CONFIG_USB=y
CONFIG_DM_USB=y
CONFIG_USB_XHCI_HCD=y
CONFIG_USB_XHCI_DWC3=y
CONFIG_USB_STORAGE=y
CONFIG_MP
CONFIG_BAREMETAL=y
CONFIG_MASTER_CORE=0
CONFIG_SYS_DDR_SDRAM_MASTER_SIZE=0x20000000
CONFIG_SYS_DDR_SDRAM_SLAVE_SIZE=0x10000000
CONFIG_GPIO_COREID_SET=y
CONFIG_GPIO_GPIO2_COREID=1
CONFIG_I2C_COREID_SET=y
CONFIG_SYS_I2C_MXC_I2C0_COREID=1
CONFIG_IRQ_COREID_SET=y
CONFIG_CMD_ICC=y
CONFIG_QSPI_COREID_SET=y
CONFIG_USB_COREID_SET=y
CONFIG_USB_USB0_COREID=1
CONFIG_USB_CTL_NUM=1
CONFIG_PCIE_COREID_SET=y
CONFIG_PCIE_PCIE2_COREID=1
CONFIG_PCIE_CTL_NUM=2
CONFIG_FS_FLEXCAN=y
CONFIG_CAN_COREID_SET=y
```

## configs/ls1043ardb_baremetal_slave_defconfig
```kconfig
CONFIG_ARM=y
CONFIG_TARGET_LS1043ARDB=y
CONFIG_TEXT_BASE=0x84000000
CONFIG_FSL_LS_PPA=y
CONFIG_NR_DRAM_BANKS=2
CONFIG_ENV_SIZE=0x2000
CONFIG_ENV_OFFSET=0x500000
CONFIG_ENV_SECT_SIZE=0x20000
CONFIG_SYS_I2C_MXC=y
CONFIG_SYS_I2C_MXC_I2C1=y
CONFIG_SYS_I2C_MXC_I2C2=y
CONFIG_SYS_I2C_MXC_I2C3=y
CONFIG_SYS_I2C_MXC_I2C4=y
CONFIG_DM_GPIO=y
CONFIG_DEFAULT_DEVICE_TREE="fsl-ls1043a-rdb"
CONFIG_ARMV8_SEC_FIRMWARE_SUPPORT=y
CONFIG_SEC_FIRMWARE_ARMV8_PSCI=y
CONFIG_DISTRO_DEFAULTS=y
CONFIG_REMAKE_ELF=y
CONFIG_MP=y
CONFIG_FIT_VERBOSE=y
CONFIG_OF_BOARD_SETUP=y
CONFIG_OF_SYSTEM_SETUP=y
CONFIG_BOOTDELAY=0
CONFIG_HUSH_PARSER=y
CONFIG_MISC_INIT_R=y
CONFIG_CMD_IMLS=y
CONFIG_SYS_EEPROM_PAGE_WRITE_DELAY_MS=5
CONFIG_CMD_DM=y
CONFIG_CMD_GPIO=y
CONFIG_CMD_DHCP=y
CONFIG_CMD_PXE=y
CONFIG_CMD_MII=y
CONFIG_CMD_PING=y
CONFIG_CMD_GPT=y
CONFIG_CMD_I2C=y
CONFIG_CMD_MMC=y
CONFIG_CMD_NAND=y
CONFIG_CMD_SF=y
CONFIG_CMD_USB=y
CONFIG_CMD_CACHE=y
CONFIG_CMD_EXT2=y
CONFIG_CMD_FAT=y
CONFIG_OF_CONTROL=y
CONFIG_DM=y
CONFIG_FSL_CAAM=y
CONFIG_ARCH_MISC_INIT=y
# CONFIG_DDR_SPD is not set
CONFIG_ECC_INIT_VIA_DDRCONTROLLER=y
CONFIG_MPC8XXX_GPIO=y
CONFIG_DM_I2C=y
CONFIG_I2C_SET_DEFAULT_BUS_NUM=y
CONFIG_SYS_I2C_EEPROM_ADDR=0x53
CONFIG_FSL_ESDHC=y
CONFIG_MTD=y
CONFIG_MTD_NOR_FLASH=y
CONFIG_FLASH_CFI_DRIVER=y
CONFIG_SYS_FLASH_USE_BUFFER_WRITE=y
CONFIG_SYS_FLASH_CFI=y
CONFIG_MTD_RAW_NAND=y
CONFIG_NAND_FSL_IFC=y
CONFIG_SYS_NAND_ONFI_DETECTION=y
CONFIG_SF_DEFAULT_BUS=1
CONFIG_SPI_FLASH_EON=y
CONFIG_SPI_FLASH_STMICRO=y
CONFIG_SPI_FLASH_SST=y
CONFIG_PHYLIB=y
CONFIG_PHY_AQUANTIA=y
CONFIG_PHY_REALTEK=y
CONFIG_PHY_VITESSE=y
CONFIG_DM_ETH=n
CONFIG_DM_MDIO=n
CONFIG_E1000=y
CONFIG_FMAN_ENET=y
CONFIG_SYS_FMAN_FW_ADDR=0x900000
CONFIG_NVME_PCI=y
CONFIG_PCI=y
CONFIG_DM_PCI=y
CONFIG_DM_PCI_COMPAT=y
CONFIG_PCIE_LAYERSCAPE_RC=y
CONFIG_SYS_QE_FW_ADDR=0x940000
CONFIG_SYS_NS16550=y
CONFIG_SPI=y
CONFIG_DM_SPI=y
CONFIG_USB=y
CONFIG_USB_XHCI_HCD=y
CONFIG_USB_XHCI_DWC3=y
CONFIG_OF_LIBFDT_OVERLAY=y
CONFIG_EFI_LOADER_BOUNCE_BUFFER=y
CONFIG_SYS_I2C=y
CONFIG_CMD_NVME=y
CONFIG_NVME=y
CONFIG_BAREMETAL=y
CONFIG_CONS_INDEX=2
CONFIG_BAREMETAL_SLAVE_MODE=y
CONFIG_ENABLE_COREID_DEBUG=y
CONFIG_ENABLE_WRITE_LOCK=y
CONFIG_FMAN_COREID_SET=y
CONFIG_FMAN_FMAN1_COREID=0
CONFIG_I2C_COREID_SET=y
CONFIG_SYS_I2C_MXC_I2C0_COREID=0
CONFIG_SYS_I2C_MXC_I2C1_COREID=1
CONFIG_SYS_I2C_MXC_I2C2_COREID=2
CONFIG_SYS_I2C_MXC_I2C3_COREID=3
CONFIG_IRQ_COREID_SET=y
CONFIG_USB_COREID_SET=y
CONFIG_USB_USB0_COREID=0
CONFIG_USB_USB1_COREID=1
CONFIG_USB_USB2_COREID=3
CONFIG_USB_CTL_NUM=3
CONFIG_PCIE_COREID_SET=y
CONFIG_PCIE_PCIE2_COREID=0
CONFIG_PCIE_PCIE3_COREID=1
CONFIG_PCIE_CTL_NUM=3
CONFIG_IFC_COREID_SET=y
```
